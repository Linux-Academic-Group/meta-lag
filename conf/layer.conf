## conf/layer.conf
```bitbake
# We have a conf and classes directory, add to BBPATH
BBPATH .= ":${LAYERDIR}"

# We have a recipes-* directories, add to BBFILES
BBFILES += " \
    ${LAYERDIR}/recipes-*/*/*.bb \
	${LAYERDIR}/recipes-*/*/*.bbappend \
"

BBFILE_COLLECTIONS += "lag-layer"
BBFILE_PATTERN_lag-layer = "^${LAYERDIR}/"
BBFILE_PRIORITY_lag-layer = "6"

LAYERSERIES_COMPAT_lag-layer = "kirkstone"
```
